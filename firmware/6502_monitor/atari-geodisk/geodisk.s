;
; geodisk.s -- installer of GEODISK.SYS: D9: RAM disk on the 6502_monitor
;              paged RAM (Atari 130XE / XL, MyDOS 4.5x)
;
; Runs once at load time (INITAD), then returns to DOS:
;   1. finds the device: $80 to $D1FF, bank count at $D1FB-$D1FC
;   2. copies the resident handler (geodisk_res.s, relocated) to MEMLO,
;      page aligned, and raises MEMLO
;   3. copies the OS ROM ($C000-$CFFF, $D800-$FFFF) to the RAM under it,
;      switches the ROM off (PORTB bit 0) and points the SIO vector SIOV
;      ($E459) at the handler: every SIO call for D9: lands there
;   4. hooks DOSINI, so that after RESET the OS copy is switched on again
;      and MEMLO stays above the handler
;
; Built at $6000 as a flat binary and wrapped into an Atari executable with
; an INITAD segment by mkgeodisk.py.  res.inc (resident image and its
; relocation table) is generated by mkgeodisk.py too.
;

        .include "atari.inc"

RES_LINK = $2000                ; address res.inc was assembled for
PTR      = $CB                  ; 2 x 2 bytes of zero page free for programs
PTR2     = $CD

        .segment "CODE"

.macro  PRINT   addr
        lda     #<addr
        ldx     #>addr
        jsr     print
.endmacro

start:
        cld
        PRINT   s_title

        ; 1. Is the device there?
        lda     #$80
        sta     $D1FF
        lda     $D1FB
        sta     count
        lda     $D1FC
        sta     count+1
        lda     #0
        sta     $D1FF
        lda     count
        ora     count+1
        beq     @nodev
        lda     count
        and     count+1
        cmp     #$FF
        bne     @found
@nodev:
        PRINT   s_nodev
        rts
@found:

        ; Already installed?  SIOV target - handler offset = a resident copy
        ; with the signature at +14.
        lda     SIOV+1
        sec
        sbc     res_image               ; handler, low byte (page aligned)
        sta     PTR
        lda     SIOV+2
        sbc     res_image+1
        clc
        adc     #>RES_LINK
        sta     PTR+1
        ldy     #14
@sig:   lda     (PTR),y
        cmp     res_image,y
        bne     @new
        iny
        cpy     #18
        bne     @sig
        PRINT   s_already
        rts
@new:

        ; 2. Resident part at MEMLO, page aligned.
        lda     MEMLO+1
        ldx     MEMLO
        beq     @aligned
        clc
        adc     #1
@aligned:
        sta     base
        sec
        sbc     #>RES_LINK
        sta     delta

        lda     #<res_image             ; copy whole pages
        sta     PTR
        lda     #>res_image
        sta     PTR+1
        lda     #0
        sta     PTR2
        lda     base
        sta     PTR2+1
        ldx     #>(RES_SIZE + 255)
        ldy     #0
@copy:  lda     (PTR),y
        sta     (PTR2),y
        iny
        bne     @copy
        inc     PTR+1
        inc     PTR2+1
        dex
        bne     @copy

        ldx     #0                      ; relocate: high bytes + delta
@reloc: cpx     #RELOC_N * 2
        beq     @relocated
        lda     reloc_tab,x
        sta     PTR2
        lda     reloc_tab+1,x
        clc
        adc     base
        sta     PTR2+1
        ldy     #0
        lda     (PTR2),y
        clc
        adc     delta
        sta     (PTR2),y
        inx
        inx
        jmp     @reloc
@relocated:

        ; Header words of the relocated copy.
        lda     #0
        sta     PTR2
        lda     base
        sta     PTR2+1
        ldy     #13
@hdr:   lda     (PTR2),y
        sta     hdr,y
        dey
        bpl     @hdr

        ; Number of sectors, PERCOM sectors per track (hi, lo).
        lda     hdr+8
        sta     PTR
        lda     hdr+9
        sta     PTR+1
        ldy     #0
        lda     count
        sta     (PTR),y
        iny
        lda     count+1
        sta     (PTR),y
        lda     hdr+10
        sta     PTR
        lda     hdr+11
        sta     PTR+1
        ldy     #2
        lda     count+1
        sta     (PTR),y
        iny
        lda     count
        sta     (PTR),y

        ; 4. DOSINI hook (the old one is called first by the handler).
        lda     hdr+6
        sta     PTR
        lda     hdr+7
        sta     PTR+1
        ldy     #0
        lda     DOSINI
        sta     (PTR),y
        iny
        lda     DOSINI+1
        sta     (PTR),y

        ; 3. OS ROM to RAM, ROM off, SIOV to the handler.  No IRQ / NMI
        ; while the vectors under the ROM are half copied.
        sei
        lda     #0
        sta     NMIEN
        lda     PORTB
        ora     #$01
        sta     pb_on
        and     #$FE
        sta     pb_off
        ldx     #$C0
@page:  cpx     #$D0                    ; $D000-$D7FF is I/O
        bcc     @do
        cpx     #$D8
        bcc     @next
@do:    stx     @src+2
        stx     @dst+2
        ldy     #0
@src:   lda     $FF00,y                 ; ROM
        sta     buf,y
        iny
        bne     @src
        lda     pb_off
        sta     PORTB
@cp:    lda     buf,y
@dst:   sta     $FF00,y                 ; RAM under the ROM
        iny
        bne     @cp
        lda     pb_on
        sta     PORTB
@next:  inx
        bne     @page

        lda     pb_off                  ; from now on the OS runs from RAM
        sta     PORTB
        lda     hdr+4                   ; original SIO target into the handler
        sta     PTR
        lda     hdr+5
        sta     PTR+1
        ldy     #0
        lda     SIOV+1
        sta     (PTR),y
        iny
        lda     SIOV+2
        sta     (PTR),y
        lda     hdr                     ; SIOV -> handler
        sta     SIOV+1
        lda     hdr+1
        sta     SIOV+2
        lda     #$40                    ; VBI on again
        sta     NMIEN
        cli

        lda     hdr+2                   ; DOSINI -> reinit
        sta     DOSINI
        lda     hdr+3
        sta     DOSINI+1
        lda     hdr+12                  ; MEMLO above the handler
        sta     MEMLO
        lda     hdr+13
        sta     MEMLO+1

        PRINT   s_ok1
        jsr     pdec
        PRINT   s_ok2
        rts

; ---------------------------------------------------------------------------
; pdec: count as a decimal number, no leading zeros.
pdec:
        lda     count
        sta     num
        lda     count+1
        sta     num+1
        lda     #0
        sta     started
        ldx     #0
@digit: ldy     #0
@sub:   lda     num
        sec
        sbc     pow10,x
        sta     tmp
        lda     num+1
        sbc     pow10+1,x
        bcc     @out
        sta     num+1
        lda     tmp
        sta     num
        iny
        bne     @sub
@out:   tya
        bne     @show
        lda     started
        bne     @show
        cpx     #8                      ; always print the last digit
        bne     @skip
@show:  sta     started
        tya
        ora     #'0'
        stx     tmp
        jsr     putc
        ldx     tmp
        lda     #1
        sta     started
@skip:  inx
        inx
        cpx     #10
        bne     @digit
        rts

pow10:  .word   10000, 1000, 100, 10, 1

print:
        sta     sptr
        stx     sptr+1
        ldy     #0
pr_loop:
sptr = * + 1
        lda     $FFFF,y
        beq     pr_done
        sty     ysave
        jsr     putc
        ldy     ysave
        iny
        bne     pr_loop
pr_done:  rts

putc:
        ldx     #0
        ldy     #PUTCHR
        sty     ICCOM
        ldy     #0
        sty     ICBLL
        sty     ICBLH
        jmp     CIOV

; ---------------------------------------------------------------------------
s_title:   .byte "GEODISK D9: RAM DISK, 6502_MONITOR", ATEOL, 0
s_nodev:   .byte "NO DEVICE: $D1FB-$D1FC READ NO BANKS", ATEOL, 0
s_already: .byte "ALREADY INSTALLED", ATEOL, 0
s_ok1:     .byte "D9: ", 0
s_ok2:     .byte " SECTORS OF 256 BYTES", ATEOL, 0

count:   .word 0
num:     .word 0
tmp:     .byte 0
started: .byte 0
ysave:   .byte 0
base:    .byte 0
delta:   .byte 0
pb_on:   .byte 0
pb_off:  .byte 0
hdr:     .res 14

        .include "res.inc"
        .assert RELOC_N < 128, error, "relocation table too long"

buf:    .res 256
